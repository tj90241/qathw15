## icp_qa_al/Kconfig
```kconfig
# SPDX-License-Identifier: GPL-2.0-only
config CRYPTO_DEV_QATHW15
	bool "Support for Intel(R) QuickAssist HW1.5"
	select CRYPTO_AEAD
	select CRYPTO_AUTHENC
	select CRYPTO_SKCIPHER
	select CRYPTO_AKCIPHER
	select CRYPTO_DH
	select CRYPTO_HMAC
	select CRYPTO_RSA
	select CRYPTO_SHA1
	select CRYPTO_SHA256
	select CRYPTO_SHA512
	select CRYPTO_LIB_AES
	select FW_LOADER

menu "Intel(R) QuickAssist HW1.5 Configuration"
    depends on X86 && PCI && CRYPTO_DEV_QATHW15

config CRYPTO_DEV_QATHW15_HOST
    bool

config CRYPTO_DEV_QATHW15_GUEST
    bool

config CRYPTO_DEV_QATHW15_LAC
	tristate "Support for host-based acceleration"
	depends on CRYPTO_DEV_QATHW15_LAC_VF=n
    select CRYPTO_DEV_QATHW15_HOST
	help
	  Support for Intel(R) QuickAssist HW1.5 Lookaside Crypto (LAC) hardware
	  for accelerating crypto workloads.

	  To compile this as a module, choose M here: the module
	  will be called icp_qa_al.

config CRYPTO_DEV_QATHW15_LAC_VF
	tristate "Support for guest-based acceleration"
    select CRYPTO_DEV_QATHW15_GUEST
	help
	  Support for Intel(R) QuickAssist HW1.5 Lookaside Crypto (LAC) virtual
	  functions for accelerating crypto workloads.

	  To compile this as a module, choose M here: the module
	  will be called icp_qa_al_vf.

config CRYPTO_DEV_QATHW15_NOIOMMU
	bool "Build without support for IOMMU"
    default n
	help
      Build Intel(R) QuickAssist HW1.5 driver with IOMMU support

endmenu
```
